## Kconfig.projbuild
```kconfig
menu "[BO] CFlash"

    config BO_CFLASH_CUSTOM_TARGET
        bool "Create custom flash configuration"
        depends on APP_BUILD_GENERATE_BINARIES
        default n

    if BO_CFLASH_CUSTOM_TARGET

        config BO_CFLASH_CUSTOM_TARGET_NAME
            string "Custom target name"
            default "cflash"
            help
                Name for the custom flash target.
                ``flasher_args_[name].json`` and ``[name]_args`` files will be generated in the build directory.

        config BO_CFLASH_OVERWRITE_FLASHER_ARGS
            bool "Overwrite flasher_args"
            default y
            help
                The default IDF build system generates build/flasher_args.json, which may be fed into esptool.py to
                perform the configured flash operations (this normally includes the bootloader, partition table,
                and factory app).
                If you wish to integrate the custom flash configuration generated by this component with your
                development environment (eg. for a typical "Build, Flash and Monitor" command), enable this option
                to automatically overwrite the default file late in the build process.

        config BO_CFLASH_FLASH_BOOTLOADER
            bool "Flash bootloader"
            depends on APP_BUILD_BOOTLOADER && !SECURE_BOOT
            default y
            help
                Add the bootloader to the custom flash configuration

        config BO_CFLASH_FLASH_PARTITION_TABLE
            bool "Flash partition table"
            default y
            help
                Add the partition table to the custom flash configuration

        config BO_CFLASH_FLASH_APP
            bool "Flash app"
            default y
            help
                Add the app to the custom flash configuration

        if BO_CFLASH_FLASH_APP

            choice BO_CFLASH_FLASH_APP_PARTITION
                prompt "App flash partition"
                default BO_CFLASH_FLASH_APP_PARTITION_FACTORY
                help
                    Set the destination partition to flash the app

                config BO_CFLASH_FLASH_APP_PARTITION_FACTORY
                    bool "Factory"
                config BO_CFLASH_FLASH_APP_PARTITION_OTA0
                    bool "OTA0"
                    depends on !PARTITION_TABLE_SINGLE_APP && !PARTITION_TABLE_SINGLE_APP_LARGE && !PARTITION_TABLE_SINGLE_APP_ENCRYPTED_NVS && !PARTITION_TABLE_SINGLE_APP_LARGE_ENC_NVS
                config BO_CFLASH_FLASH_APP_PARTITION_OTA1
                    bool "OTA1"
                    depends on !PARTITION_TABLE_SINGLE_APP && !PARTITION_TABLE_SINGLE_APP_LARGE && !PARTITION_TABLE_SINGLE_APP_ENCRYPTED_NVS && !PARTITION_TABLE_SINGLE_APP_LARGE_ENC_NVS
                config BO_CFLASH_FLASH_APP_PARTITION_TEST
                    bool "Test"
                    depends on !PARTITION_TABLE_SINGLE_APP && !PARTITION_TABLE_SINGLE_APP_LARGE && !PARTITION_TABLE_SINGLE_APP_ENCRYPTED_NVS && !PARTITION_TABLE_SINGLE_APP_LARGE_ENC_NVS && !PARTITION_TABLE_TWO_OTA && !PARTITION_TABLE_TWO_OTA_ENCRYPTED_NVS
                config BO_CFLASH_FLASH_APP_PARTITION_CUSTOM_PARTITION
                    bool "Custom"
                config BO_CFLASH_FLASH_APP_PARTITION_CUSTOM_SET_OFFSET
                    bool "Offset"
            endchoice

            if BO_CFLASH_FLASH_APP_PARTITION_CUSTOM_PARTITION

                config BO_CFLASH_FLASH_APP_PARTITION_TYPE
                    hex "App partition type"
                    default 0x00
                    range 0x00 0xFF
                    help
                        For reference: "app" = 0x0

                config BO_CFLASH_FLASH_APP_PARTITION_SUBTYPE
                    hex "App partition subtype"
                    default 0x00
                    range 0x00 0xFF
                    help
                        For reference: "factory" = 0x0; "ota_0" = 0x10 to "ota_15" = 0x1F; "test" = 0x20

            endif # BO_CFLASH_FLASH_APP_PARTITION_CUSTOM_PARTITION

            if BO_CFLASH_FLASH_APP_PARTITION_CUSTOM_SET_OFFSET

                config BO_CFLASH_FLASH_APP_PARTITION_CUSTOM_OFFSET
                    hex "App flash offset"
                    default 0x10000
                    range 0x1000 0xFFFFFFFF

            endif # BO_CFLASH_FLASH_APP_PARTITION_CUSTOM_SET_OFFSET

            if !BO_CFLASH_FLASH_APP_PARTITION_CUSTOM_PARTITION && !BO_CFLASH_FLASH_APP_PARTITION_CUSTOM_SET_OFFSET

                config BO_CFLASH_FLASH_APP_PARTITION_TYPE
                    hex
                    default 0x00

                config BO_CFLASH_FLASH_APP_PARTITION_SUBTYPE
                    default 0x00 if BO_CFLASH_FLASH_APP_PARTITION_FACTORY
                    default 0x10 if BO_CFLASH_FLASH_APP_PARTITION_OTA0
                    default 0x11 if BO_CFLASH_FLASH_APP_PARTITION_OTA1
                    default 0x20 if BO_CFLASH_FLASH_APP_PARTITION_TEST

            endif # !BO_CFLASH_FLASH_APP_PARTITION_CUSTOM_PARTITION && !BO_CFLASH_FLASH_APP_PARTITION_CUSTOM_SET_OFFSET

        endif # BO_CFLASH_FLASH_APP

        config BO_CFLASH_SET_BOOT
            bool "Set boot partition"
            default n
            help
                Flash the ota_data partition (if it exists) to set the specified boot partition.

        if BO_CFLASH_SET_BOOT

            choice BO_CFLASH_SET_BOOT_CONFIG
                prompt "Boot partition"
                default BO_CFLASH_SET_BOOT_CONFIG_CURRENT
                help
                    Select which partition to activate as the boot partition via ota_data.

                config BO_CFLASH_SET_BOOT_CONFIG_CURRENT
                    bool "Current"
                    depends on BO_CFLASH_FLASH_APP && !BO_CFLASH_FLASH_APP_PARTITION_CUSTOM_SET_OFFSET
                config BO_CFLASH_SET_BOOT_CONFIG_FACTORY
                    bool "Factory"
                config BO_CFLASH_SET_BOOT_CONFIG_OTA_0
                    bool "OTA0"
                    depends on !PARTITION_TABLE_SINGLE_APP && !PARTITION_TABLE_SINGLE_APP_LARGE && !PARTITION_TABLE_SINGLE_APP_ENCRYPTED_NVS && !PARTITION_TABLE_SINGLE_APP_LARGE_ENC_NVS
                config BO_CFLASH_SET_BOOT_CONFIG_OTA_1
                    bool "OTA1"
                    depends on !PARTITION_TABLE_SINGLE_APP && !PARTITION_TABLE_SINGLE_APP_LARGE && !PARTITION_TABLE_SINGLE_APP_ENCRYPTED_NVS && !PARTITION_TABLE_SINGLE_APP_LARGE_ENC_NVS
                config BO_CFLASH_SET_BOOT_CONFIG_CUSTOM
                    bool "Custom"
            endchoice

            if BO_CFLASH_SET_BOOT_CONFIG_CUSTOM

                config BO_CFLASH_SET_BOOT_CONFIG_PARTITION_SUBTYPE
                    hex "Boot partition subtype"
                    default 0x00
                    range 0x00 0x1F
                    help
                        For reference: "factory" = 0x0; "ota_0" = 0x10 to "ota_15" = 0x1F

            endif # BO_CFLASH_SET_BOOT_CONFIG_CUSTOM

            if !BO_CFLASH_SET_BOOT_CONFIG_CURRENT && !BO_CFLASH_SET_BOOT_CONFIG_CUSTOM

                config BO_CFLASH_SET_BOOT_CONFIG_PARTITION_SUBTYPE
                    default 0x00 if BO_CFLASH_SET_BOOT_CONFIG_FACTORY
                    default 0x10 if BO_CFLASH_SET_BOOT_CONFIG_OTA_0
                    default 0x11 if BO_CFLASH_SET_BOOT_CONFIG_OTA_1

            endif # !BO_CFLASH_SET_BOOT_CONFIG_CURRENT && !BO_CFLASH_SET_BOOT_CONFIG_CUSTOM

        endif # BO_CFLASH_SET_BOOT

        config BO_CFLASH_FLASH_CUSTOM_BIN_1
            bool "Add custom binary (1)"
            default n
            help
                Add a custom binary to the flash configuration

        if BO_CFLASH_FLASH_CUSTOM_BIN_1

            config BO_CFLASH_FLASH_CUSTOM_BIN_1_PATH
                string "Custom binary (1) path"
                help
                    Filepath relative to the build directory

            choice BO_CFLASH_FLASH_CUSTOM_BIN_1_CONFIG
                prompt "Custom binary (1) partition config"
                default BO_CFLASH_FLASH_CUSTOM_BIN_1_CONFIG_TYPES

                config BO_CFLASH_FLASH_CUSTOM_BIN_1_CONFIG_TYPES
                    bool "Types"
                config BO_CFLASH_FLASH_CUSTOM_BIN_1_CONFIG_SET_OFFSET
                    bool "Offset"
            endchoice

            if BO_CFLASH_FLASH_CUSTOM_BIN_1_CONFIG_TYPES
                config BO_CFLASH_FLASH_CUSTOM_BIN_1_PARTITION_TYPE
                    hex "Custom binary (1) partition type"
                    default 0x01
                    range 0x00 0xFF
                    help
                        For reference: "app" = 0x0, "data" = 0x1

                config BO_CFLASH_FLASH_CUSTOM_BIN_1_PARTITION_SUBTYPE
                    hex "Custom binary (1) partition subtype"
                    default 0x82
                    range 0x00 0xFF
                    help
                        For reference:
                            App: "factory" = 0x0; "ota_0" = 0x10 to "ota_15" = 0x1F; "test" = 0x20
                            Data: "ota" = 0x0, "nvs" = 0x2, "nvs_keys" = 0x4, "fat" = 0x81, "spiffs" = 0x82

            endif # BO_CFLASH_FLASH_CUSTOM_BIN_1_CONFIG_TYPES

            if BO_CFLASH_FLASH_CUSTOM_BIN_1_CONFIG_SET_OFFSET

                config BO_CFLASH_FLASH_CUSTOM_BIN_1_OFFSET
                    hex "Custom binary (1) offset"
                    default 0x100000
                    range 0x1000 0xFFFFFFFF

            endif # BO_CFLASH_FLASH_CUSTOM_BIN_1_CONFIG_SET_OFFSET

        endif # BO_CFLASH_FLASH_CUSTOM_BIN_1

        config BO_CFLASH_FLASH_CUSTOM_BIN_2
            bool "Add custom binary (2)"
            default n
            help
                Add a custom binary to the flash configuration

            if BO_CFLASH_FLASH_CUSTOM_BIN_2

                config BO_CFLASH_FLASH_CUSTOM_BIN_2_PATH
                    string "Custom binary (2) path"
                    help
                        Filepath relative to the build directory

                choice BO_CFLASH_FLASH_CUSTOM_BIN_2_CONFIG
                    prompt "Custom binary (2) partition config"
                    default BO_CFLASH_FLASH_CUSTOM_BIN_2_CONFIG_TYPES

                    config BO_CFLASH_FLASH_CUSTOM_BIN_2_CONFIG_TYPES
                        bool "Types"
                    config BO_CFLASH_FLASH_CUSTOM_BIN_2_CONFIG_SET_OFFSET
                        bool "Offset"
                endchoice

                if BO_CFLASH_FLASH_CUSTOM_BIN_2_CONFIG_TYPES
                    config BO_CFLASH_FLASH_CUSTOM_BIN_2_PARTITION_TYPE
                        hex "Custom binary (2) partition type"
                        default 0x01
                        range 0x00 0xFF
                        help
                            For reference: "app" = 0x0, "data" = 0x1

                    config BO_CFLASH_FLASH_CUSTOM_BIN_2_PARTITION_SUBTYPE
                        hex "Custom binary (2) partition subtype"
                        default 0x82
                        range 0x00 0xFF
                        help
                            For reference:
                                App: "factory" = 0x0; "ota_0" = 0x10 to "ota_15" = 0x1F; "test" = 0x20
                                Data: "ota" = 0x0, "nvs" = 0x2, "nvs_keys" = 0x4, "fat" = 0x81, "spiffs" = 0x82

                endif # BO_CFLASH_FLASH_CUSTOM_BIN_2_CONFIG_TYPES

                if BO_CFLASH_FLASH_CUSTOM_BIN_2_CONFIG_SET_OFFSET

                    config BO_CFLASH_FLASH_CUSTOM_BIN_2_OFFSET
                        hex "Custom binary (2) offset"
                        default 0x100000
                        range 0x1000 0xFFFFFFFF

                endif # BO_CFLASH_FLASH_CUSTOM_BIN_2_CONFIG_SET_OFFSET

            endif # BO_CFLASH_FLASH_CUSTOM_BIN_2

    endif # BO_CFLASH_CUSTOM_TARGET

endmenu
```
